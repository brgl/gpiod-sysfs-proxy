## tests/yocto/conf/layer.conf
```bitbake
BBPATH .= ":${LAYERDIR}"

BBFILES += "${LAYERDIR}/recipes-*/*/*.bb \
            ${LAYERDIR}/recipes-*/*/*.bbappend"

BBFILE_COLLECTIONS += "gpiod-sysfs-proxy-tests"
BBFILE_PATTERN_gpiod-sysfs-proxy-tests = "^${LAYERDIR}/"
BBFILE_PRIORITY_gpiod-sysfs-proxy-tests = "6"

# TODO: Fixup
LAYERSERIES_COMPAT_gpiod-sysfs-proxy-tests = "wrynose master"
```
